#include <Arduino.h>

#include <Wire.h>
#include <Adafruit_GFX.h>
#include <Adafruit_SSD1306.h>
#include "apwifieeprommode.h"
#include "secrets.h"
#include <EEPROM.h>
#include <WiFi.h>
#include <WiFiClientSecure.h>
#include <PubSubClient.h>
#include <ArduinoJson.h>
#include <time.h>


void iniciarRescate();
void iniciarPintaFeliz();
void iniciarSimonDice();
void iniciarTrazaFacil();
bool pixelEnBitmap(const unsigned char* bitmap, int x, int y);
bool menuRecienIniciado = true;

// ── Pantalla ─────────────────────────────────────────────────
#define SCREEN_WIDTH  128
#define SCREEN_HEIGHT  64
Adafruit_SSD1306 display(SCREEN_WIDTH, SCREEN_HEIGHT, &Wire, -1);

// ── Pines joystick ───────────────────────────────────────────
#define JOY_VER  35   // vertical   (arriba/abajo)
#define JOY_HOR  34   // horizontal (izq/der)  — no usado aún
#define JOY_SW   32   // botón central del joystick

// ── Zona muerta del joystick ─────────────────────────────────
#define JOY_CENTRO   2048   // valor central ADC 12-bit
#define JOY_UMBRAL    700   // cuánto alejarse del centro para contar

// ── Debounce (ms mínimo entre cambios de pantalla) ───────────
#define DEBOUNCE_MS  300

// ── Número de pantallas de menú ──────────────────────────────
#define NUM_MENUS 4

// ── Índice de la pantalla actual ─────────────────────────────
int menuActual = 0;

// Tiempo de la última navegación (para debounce)
unsigned long tUltimoMovimiento = 0;


#define BTN_ROJO      4
#define BTN_VERDE     5
#define BTN_AMARILLO  33
#define BTN_AZUL      23

#define LED_VERDE     25
#define LED_ROJO      27
#define LED_AMARILLO  26
#define LED_NARANJA   19
#define LED_AZUL      18

#define BUZZER_PIN    17

const uint8_t buttonPins[4] ={ BTN_ROJO, BTN_VERDE, BTN_AMARILLO, BTN_AZUL};

const uint8_t ledPins[4] ={ LED_ROJO, LED_VERDE, LED_AMARILLO, LED_AZUL };

const int gameTones[4] = { 196, 262, 330, 784 };

// ── Simón dice ─────────────────────────

#define MAX_GAME_LENGTH 100
uint8_t gameSequence[MAX_GAME_LENGTH];
uint8_t gameIndex = 0;

// ── Bitmaps (Menu) ─────────────────────────

const unsigned char epd_bitmap_inicio [] PROGMEM = {
	0x00, 0x00, 0x00, 0x00, 0x00, 0x00, 0x00, 0x00, 0x00, 0x00, 0x00, 0x00, 0x00, 0x00, 0x00, 0x00, 
	0x01, 0xff, 0xff, 0xff, 0xff, 0xff, 0xff, 0xff, 0xff, 0xff, 0xff, 0xff, 0xff, 0xff, 0xff, 0x00, 
	0x03, 0xff, 0xff, 0xff, 0xff, 0xff, 0xff, 0xff, 0xff, 0xff, 0xff, 0xff, 0xff, 0xff, 0xff, 0xc0, 
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	0x00, 0x00, 0x00, 0x00, 0x00, 0x00, 0x00, 0x00, 0x00, 0x00, 0x00, 0x00, 0x00, 0x00, 0x00, 0x00
};


// ── Bitmaps (Menu) ─────────────────────────
const unsigned char epd_bitmap_Menu[] PROGMEM = {
  0x00,0x00,0x00,0x00,0x00,0x00,0x00,0x00,0x00,0x00,0x00,0x00,0x00,0x00,0x00,0x00,
  0x00,0x00,0x00,0x00,0x00,0x00,0x00,0x00,0x00,0x00,0x00,0x00,0x00,0x00,0x00,0x02,
  0x00,0x3e,0x00,0x00,0x00,0x00,0x00,0x00,0x00,0x00,0x00,0x00,0x00,0x00,0x00,0x00,
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  0x00,0x00,0x00,0x00,0x00,0x00,0x00,0x00,0x00,0x00,0x00,0x00,0x00,0x00,0x00,0x02
};

const unsigned char epd_bitmap_Menu2[] PROGMEM = {
  0x00,0x00,0x00,0x00,0x00,0x00,0x00,0x00,0x00,0x00,0x00,0x00,0x00,0x00,0x00,0x00,
  0x00,0x00,0x00,0x00,0x00,0x00,0x00,0x00,0x00,0x00,0x00,0x00,0x00,0x00,0x00,0x02,
  0x00,0x00,0x00,0x00,0x00,0x00,0x00,0x00,0x00,0x00,0x00,0x00,0x00,0x00,0x00,0x00,
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  0x00,0x00,0x00,0x00,0x00,0x00,0x00,0x00,0x00,0x00,0x00,0x00,0x00,0x00,0x00,0x02
};

const unsigned char epd_bitmap_Menu3[] PROGMEM = {
  0x00,0x00,0x00,0x00,0x00,0x00,0x00,0x00,0x00,0x00,0x00,0x00,0x00,0x00,0x00,0x00,
  0x00,0x00,0x00,0x00,0x00,0x00,0x00,0x00,0x00,0x00,0x00,0x00,0x00,0x00,0x00,0x02,
  0x00,0x3e,0x00,0x00,0x00,0x00,0x00,0x00,0x00,0x00,0x00,0x00,0x00,0x00,0x00,0x00,
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  0x00,0x00,0x00,0x00,0x00,0x00,0x00,0x00,0x00,0x00,0x00,0x00,0x00,0x00,0x00,0x02
};

const unsigned char epd_bitmap_Menu4[] PROGMEM = {
  0x00,0x00,0x00,0x00,0x00,0x00,0x00,0x00,0x00,0x00,0x00,0x00,0x00,0x00,0x00,0x00,
  0x00,0x00,0x00,0x00,0x00,0x00,0x00,0x00,0x00,0x00,0x00,0x00,0x00,0x00,0x00,0x02,
  0x0f,0xff,0xf8,0x00,0x00,0x00,0x00,0x00,0x00,0x00,0x00,0x00,0x00,0x00,0x00,0x00,
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  0x00,0x00,0x00,0x00,0x00,0x00,0x00,0x00,0x00,0x00,0x00,0x00,0x00,0x00,0x00,0x02
};

// ── Bitmaps (Pinta Feliz) ─────────────────────────


const unsigned char epd_bitmap_PintaFeliz_N1 [] PROGMEM = {
	0x00, 0x00, 0x00, 0x00, 0x00, 0x00, 0x00, 0x00, 0x00, 0x00, 0x00, 0x00, 0x00, 0x00, 0x00, 0x00, 
	0x00, 0x00, 0x00, 0x00, 0x00, 0x00, 0x00, 0x00, 0x00, 0x00, 0x00, 0x00, 0x00, 0x00, 0x00, 0x00, 
	0x00, 0x00, 0x00, 0x00, 0x00, 0x00, 0x00, 0x00, 0x00, 0x00, 0x00, 0x00, 0x00, 0x00, 0x00, 0x00, 
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	0x00, 0x00, 0x00, 0x00, 0x00, 0x00, 0x00, 0x00, 0x00, 0x00, 0x00, 0x00, 0x00, 0x00, 0x00, 0x00
};

const unsigned char epd_bitmap_PintaFeliz_N2 [] PROGMEM = {
	0x00, 0x00, 0x00, 0x00, 0x00, 0x00, 0x00, 0x00, 0x00, 0x00, 0x00, 0x00, 0x00, 0x00, 0x00, 0x00, 
	0x00, 0x00, 0x00, 0x00, 0x00, 0x00, 0x00, 0x00, 0x00, 0x00, 0x00, 0x00, 0x00, 0x00, 0x00, 0x00, 
	0x00, 0x00, 0x00, 0x00, 0x00, 0x00, 0x00, 0x00, 0x00, 0x00, 0x00, 0x00, 0x00, 0x00, 0x00, 0x00, 
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	0x00, 0x00, 0x00, 0x00, 0x00, 0x00, 0x00, 0x00, 0x00, 0x00, 0x00, 0x00, 0x00, 0x00, 0x00, 0x00
};

const unsigned char epd_bitmap_PintaFeliz_N3 [] PROGMEM = {
	0x00, 0x00, 0x00, 0x00, 0x00, 0x00, 0x00, 0x00, 0x00, 0x00, 0x00, 0x00, 0x00, 0x00, 0x00, 0x00, 
	0x00, 0x00, 0x00, 0x00, 0x00, 0x00, 0x00, 0x00, 0x00, 0x00, 0x00, 0x00, 0x00, 0x00, 0x00, 0x00, 
	0x00, 0x00, 0x00, 0x00, 0x00, 0x00, 0x00, 0x00, 0x00, 0x00, 0x00, 0x00, 0x00, 0x00, 0x00, 0x00, 
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	0x00, 0x00, 0x00, 0x00, 0x00, 0x00, 0x00, 0x00, 0x00, 0x00, 0x00, 0x00, 0x00, 0x00, 0x00, 0x00
};



// Bitmpa Traza Facil
const unsigned char epd_bitmap_Traza_Facil [] PROGMEM ={
	0x00, 0x00, 0x00, 0x00, 0x00, 0x00, 0x00, 0x00, 0x00, 0x00, 0x00, 0x00, 0x00, 0x00, 0x00, 0x00, 
	0x00, 0x00, 0x00, 0x00, 0x00, 0x00, 0x00, 0x00, 0x00, 0x00, 0x00, 0x00, 0x00, 0x00, 0x00, 0x00, 
	0x00, 0x00, 0x00, 0x00, 0x00, 0x00, 0x00, 0x00, 0x00, 0x00, 0x00, 0x00, 0x00, 0x00, 0x00, 0x00, 
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	0x00, 0x00, 0x00, 0x00, 0x00, 0x00, 0x00, 0x00, 0x00, 0x00, 0x00, 0x00, 0x00, 0x00, 0x00, 0x00
};

// Bitmap Rescate
const unsigned char epd_bitmap_Rescate [] PROGMEM = {
	0x00, 0x00, 0x00, 0x00, 0x00, 0x00, 0x00, 0x00, 0x00, 0x00, 0x03, 0xf0, 0x00, 0x00, 0x00, 0x00, 
	0x00, 0x00, 0x00, 0x00, 0x00, 0x00, 0x00, 0x00, 0x00, 0x00, 0x1f, 0xfe, 0x00, 0x00, 0x00, 0x00, 
	0x00, 0x00, 0x00, 0x00, 0x00, 0x00, 0x00, 0x00, 0x00, 0x00, 0x7f, 0xff, 0x80, 0x00, 0x00, 0x00, 
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	0x00, 0x0f, 0xfc, 0x00, 0x00, 0x00, 0x00, 0x00, 0x01, 0xf0, 0x00, 0x00, 0x00, 0x00, 0x00, 0x00
};


// ── Array de punteros a los 4 bitmaps ─────────────────────────
// Permite navegar con menuActual como índice
const unsigned char* menus[NUM_MENUS] = {
  epd_bitmap_Menu,
  epd_bitmap_Menu2,
  epd_bitmap_Menu3,
  epd_bitmap_Menu4
};

// ============================================================
//  Dibuja el bitmap del menú actual en la pantalla
// ============================================================
void mostrarMenu(int indice) {
  display.clearDisplay();
  display.drawBitmap(0, 0, menus[indice], SCREEN_WIDTH, SCREEN_HEIGHT, 1);
  display.display();
}

// Se ejecuta una sola vez por encendido, despues de conectarse al WiFi.
void animacionInicioArcade() {
  if (!menuRecienIniciado || WiFi.status() != WL_CONNECTED) return;

  // Se escriben los cinco pines de forma explicita para que la prueba de
  // encendido tambien valide los LED rojo y verde.
  const uint8_t ledsInicio[5] = {
    LED_ROJO, LED_VERDE, LED_AMARILLO, LED_AZUL, LED_NARANJA
  };

  for (int i = 0; i < 5; i++) {
    pinMode(ledsInicio[i], OUTPUT);
    digitalWrite(ledsInicio[i], LOW);
  }

  // Prueba corta individual: permite comprobar visualmente cada color.
  for (int i = 0; i < 5; i++) {
    digitalWrite(ledsInicio[i], HIGH);
    tone(BUZZER_PIN, 900 + (i * 180));
    delay(160);
    digitalWrite(ledsInicio[i], LOW);
  }

  // Confirmacion final: todos los LED encendidos al mismo tiempo.
  for (int i = 0; i < 5; i++) {
    digitalWrite(ledsInicio[i], HIGH);
  }
  tone(BUZZER_PIN, 1500);

  delay(800);

  noTone(BUZZER_PIN);
  for (int i = 0; i < 5; i++) {
    digitalWrite(ledsInicio[i], LOW);
  }
  menuRecienIniciado = false;
}




// MQTT: el ESP32 solo publica metricas. El backend es el unico componente
// autorizado para escribir en Firebase.
WiFiClientSecure mqttTlsClient;
PubSubClient mqttClient(mqttTlsClient);
unsigned long secuenciaMensajes = 0;

void inicializarMQTT() {
  mqttClient.setServer(MQTT_HOST, MQTT_PORT);
  mqttClient.setBufferSize(1024);
  mqttClient.setKeepAlive(30);
  mqttClient.setSocketTimeout(8);

  if (strlen(MQTT_ROOT_CA) > 0) {
    mqttTlsClient.setCACert(MQTT_ROOT_CA);
  } else {
    mqttTlsClient.setInsecure();
    Serial.println("ADVERTENCIA: MQTT TLS sin validacion de certificado.");
  }
}

bool conectarMQTT() {
  if (mqttClient.connected()) return true;
  if (WiFi.status() != WL_CONNECTED) {
    Serial.println("Sin WiFi -> no se puede conectar al broker MQTT.");
    return false;
  }

  String clientId = String(MQTT_DEVICE_ID) + "-" +
                    String((uint32_t)(ESP.getEfuseMac() & 0xFFFFFFFF), HEX);

  for (int intento = 1; intento <= 3; intento++) {
    Serial.printf("Conectando a HiveMQ (%d/3)...\n", intento);
    if (mqttClient.connect(clientId.c_str(), MQTT_USERNAME, MQTT_PASSWORD)) {
      Serial.println("MQTT conectado.");
      return true;
    }
    Serial.printf("MQTT fallo, estado=%d\n", mqttClient.state());
    delay(750);
  }
  return false;
}





//------------------------------------------------------------ 
//  HORA POR NTP
// Ecuador: UTC-5, sin horario de verano
void configurarHoraNTP() {
  configTime(-5 * 3600, 0, "pool.ntp.org", "time.nist.gov");
  Serial.println("Sincronizando hora NTP...");
}
 
// Llena fecha ("21/07/2026") y hora ("13:30") reales.
// Devuelve false si aun no logro sincronizar (usa un timeout corto).
bool obtenerFechaHora(String &fecha, String &hora) {
  struct tm timeinfo;
  if (!getLocalTime(&timeinfo, 5000)) {
    fecha = "00/00/0000";
    hora  = "00:00";
    return false;
  }
  char bufFecha[11];
  strftime(bufFecha, sizeof(bufFecha), "%d/%m/%Y", &timeinfo);
  char bufHora[6];
  strftime(bufHora, sizeof(bufHora), "%H:%M", &timeinfo);
  fecha = String(bufFecha);
  hora  = String(bufHora);
  return true;
}
 
// Convierte milisegundos a formato "1.30 min" (1 min 30 seg)
String formatearDuracion(unsigned long duracionMs) {
  unsigned long totalSegundos = duracionMs / 1000;
  unsigned long minutos  = totalSegundos / 60;
  unsigned long segundos = totalSegundos % 60;
  char buf[12];
  snprintf(buf, sizeof(buf), "%lu.%02lu min", minutos, segundos);
  return String(buf);
}
 
 
// Publica una metrica JSON en arcade/<dispositivoId>/metricas.
void enviarMetricaJuego(const char* juego, unsigned long duracionMs, const String &resultado) {
  String fecha, hora;
  bool horaSincronizada = obtenerFechaHora(fecha, hora);
  String duracionStr = formatearDuracion(duracionMs);

  // ── La carpeta ahora es el nombre del juego, no "partidas" ──
  String carpeta = String(juego);
  carpeta.replace(" ", "");

  int valor = 0;
  bool tieneValor = false;
  for (size_t i = 0; i < resultado.length(); i++) {
    if (isDigit(resultado[i])) {
      tieneValor = true;
      valor = valor * 10 + (resultado[i] - '0');
    }
  }
  String juegoNormalizado = String(juego);
  juegoNormalizado.toLowerCase();
  time_t ahora = 0;
  if (horaSincronizada) time(&ahora);
  secuenciaMensajes++;
  String idMensaje = String(MQTT_DEVICE_ID) + "-" +
                     String((unsigned long)ahora) + "-" +
                     String(secuenciaMensajes);

  JsonDocument metrica;
  metrica["idMensaje"] = idMensaje;
  metrica["dispositivoId"] = MQTT_DEVICE_ID;
  metrica["juego"] = carpeta;
  metrica["duracion"] = duracionStr;
  metrica["duracionMs"] = duracionMs;
  metrica["resultado"] = resultado;
  metrica["fecha"] = fecha;
  metrica["hora"] = hora;
  if (horaSincronizada) metrica["timestamp"] = (unsigned long)ahora;
  if (tieneValor && juegoNormalizado.indexOf("simon") >= 0)
    metrica["puntaje"] = valor;
  if (tieneValor && juegoNormalizado.indexOf("pinta") >= 0)
    metrica["nivel"] = valor;

  String payload;
  serializeJson(metrica, payload);
  String topic = "arcade/" + String(MQTT_DEVICE_ID) + "/metricas";

  if (!conectarMQTT()) {
    Serial.println("Metrica NO publicada: broker MQTT no disponible.");
    return;
  }

  bool publicada = mqttClient.publish(topic.c_str(), payload.c_str(), false);
  mqttClient.loop();
  Serial.printf("MQTT %s -> %s\n", publicada ? "publicado" : "fallo", topic.c_str());
  if (!publicada) Serial.println(payload);
}




// ============================================================
//  setup()
// ============================================================
void setup() {
  Serial.begin(115200);
 
  // 1. Pantalla lista PRIMERO (antes de tocar WiFi)
  Wire.begin(21, 22);
  if (!display.begin(SSD1306_SWITCHCAPVCC, 0x3C)) {
    Serial.println("Error: pantalla OLED no encontrada");
    for (;;);
  }
 
  // 2. Mostrar pantalla de "sin conexion" MIENTRAS no hay WiFi
  display.clearDisplay();
  display.drawBitmap(0, 0, epd_bitmap_inicio, 128, 64, 1);
  display.display();
 
  // 3. API WiFi (bloqueante: se queda aqui hasta conectar,
  //    sea por red guardada o por el portal 192.168.4.1)
  intentoconexion("espgroup5", "12341243");
 
  // 4. Ya hay WiFi conectado -> hora real y broker MQTT
  configurarHoraNTP();
  inicializarMQTT();
  conectarMQTT();
 
  // 5. Preparar pines del juego
  pinMode(JOY_SW, INPUT_PULLUP);
  for (int i = 0; i < 4; i++) {
    pinMode(buttonPins[i], INPUT_PULLUP);
    pinMode(ledPins[i], OUTPUT);
  }
  pinMode(LED_NARANJA, OUTPUT);
  randomSeed(micros());
 
  // 6. Reemplazar la pantalla de inicio por el menu del juego
  mostrarMenu(menuActual);
  animacionInicioArcade();
  Serial.println("NeuroPlay iniciado. Menu: 0");
}

// ============================================================
//  loop()
// ============================================================
void loop() {
  if (mqttClient.connected()) mqttClient.loop();

  unsigned long ahora = millis();
  

  // Solo procesar si pasó el tiempo de debounce
  if (ahora - tUltimoMovimiento < DEBOUNCE_MS) return;

  int ver = analogRead(JOY_VER);   // 0–4095

  // ── Joystick ABAJO → siguiente menú ──────────────────────
  // El eje vertical del KY-023: arriba ≈ 0, centro ≈ 2048, abajo ≈ 4095
  if (ver > JOY_CENTRO + JOY_UMBRAL) {
    menuActual = (menuActual + 1) % NUM_MENUS;  // circular: 3→0
    mostrarMenu(menuActual);
    tUltimoMovimiento = ahora;
    Serial.print("Abajo → Menu: ");
    Serial.println(menuActual);
  }

  // ── Joystick ARRIBA → menú anterior ──────────────────────
  else if (ver < JOY_CENTRO - JOY_UMBRAL) {
    menuActual = (menuActual - 1 + NUM_MENUS) % NUM_MENUS;  // circular: 0→3
    mostrarMenu(menuActual);
    tUltimoMovimiento = ahora;
    Serial.print("Arriba → Menu: ");
    Serial.println(menuActual);
  }

  // ── Botón del joystick (SW) → seleccionar juego ──────────
  // Por ahora solo imprime, aquí luego llamas a la función del juego
  if (digitalRead(JOY_SW) == LOW){
    Serial.print("Seleccionado menuActual = ");
    Serial.println(menuActual);

    delay(250);

    switch(menuActual){
      case 0:
        iniciarRescate();
        mostrarMenu(menuActual);
        break;
      case 1:               //Pinta Feliz
        iniciarPintaFeliz();
        mostrarMenu(menuActual);
        break;
      case 2:              // Simón dice
        iniciarSimonDice();
        mostrarMenu(menuActual);
        break;
      case 3:
        iniciarTrazaFacil();
        mostrarMenu(menuActual);
        break;
    }

    tUltimoMovimiento = millis();
  }

}




void dibujarJuegoNavegacion(const unsigned char* bmp, int cx, int cy,
                             uint16_t colorCursor) {
  display.clearDisplay();
  display.drawBitmap(0, 0, bmp, 128, 64, 1);
  // Cursor 3x3
  for (int dy = -1; dy <= 1; dy++)
    for (int dx = -1; dx <= 1; dx++)
      display.drawPixel(cx + dx, cy + dy, SSD1306_WHITE);
  display.display();
}

// ── Animacion de game over compartida ────────────────────────
void animacionGameOverNav() {
  tone(BUZZER_PIN, 150); digitalWrite(LED_NARANJA, HIGH);
  delay(350); noTone(BUZZER_PIN);
  tone(BUZZER_PIN, 100); delay(350); noTone(BUZZER_PIN);
  tone(BUZZER_PIN, 80);  delay(500); noTone(BUZZER_PIN);
  digitalWrite(LED_NARANJA, LOW);

  display.clearDisplay();
  display.setTextSize(1);
  display.setTextColor(SSD1306_WHITE);
  display.setCursor(28, 10); display.println("Chocaste :C");
  display.setCursor(34, 27); display.println("Vuelve a");
  display.setCursor(22, 44); display.println("intentarlo :)");
  display.display();
  delay(2000);
}

// ── Animacion de victoria compartida ─────────────────────────
void animacionVictoriaNav() {
  int notas[] = {523, 659, 784, 1047};
  for (int i = 0; i < 4; i++) { tone(BUZZER_PIN, notas[i]); delay(120); }
  noTone(BUZZER_PIN);

  for (int i = 0; i < 4; i++) {
    for (int j = 0; j < 4; j++) digitalWrite(ledPins[j], HIGH);
    digitalWrite(LED_NARANJA, HIGH);
    delay(180);
    for (int j = 0; j < 4; j++) digitalWrite(ledPins[j], LOW);
    digitalWrite(LED_NARANJA, LOW);
    delay(180);
  }

  display.clearDisplay();
  display.setTextSize(2);
  display.setTextColor(SSD1306_WHITE);
  display.setCursor(10, 5);  display.println("LLEGASTE");
  display.setCursor(20, 35); display.println("  :D");
  display.display();
  delay(2500);
}

// Devuelve true mientras al menos un pixel del cursor siga tocando la
// linea blanca. La OLED es monocromatica, por eso el cursor se distingue
// por ser un cuadrado de 3x3, mas grueso que el camino.
bool cursorSobreLinea(const unsigned char* bmp, int cx, int cy, int radio) {
  for (int dy = -radio; dy <= radio; dy++)
    for (int dx = -radio; dx <= radio; dx++)
      if (pixelEnBitmap(bmp, cx + dx, cy + dy))
        return true;

  return false;
}

// ============================================================
//  TRAZA FACIL (seguidor de linea)
//  - El camino es una linea BLANCA sobre fondo NEGRO
//  - El cursor inicia en el extremo inferior izquierdo
//  - Gana al llegar al extremo inferior derecho
//  - Pierde solo cuando el cursor queda completamente fuera de la linea
// ============================================================
void iniciarTrazaFacil()
{
    // Centros reales de los puntos verde y rojo de la imagen de referencia.
    // Con radio 1, el cursor inicial en (2, 61) toca la linea de x=3..4.
    constexpr int START_X = 2;
    constexpr int START_Y = 61;

    constexpr int META_X = 125;
    constexpr int META_Y = 59;

    constexpr float VEL = 1.2f;
    constexpr int ZONA_MUERTA = 600;
    constexpr int RADIO_META = 8;
    constexpr int RADIO_CURSOR = 1;

    // Mostrar el cursor desde el primer instante en el punto de inicio.
    dibujarJuegoNavegacion(epd_bitmap_Traza_Facil, START_X, START_Y, 1);
    delay(800);

    float cx = START_X;
    float cy = START_Y;
    unsigned long tInicioJuego = millis();

    unsigned long tFrame = 0;

    while (true)
    {
        if (!digitalRead(JOY_SW))
        {
            delay(300);
            enviarMetricaJuego("trazaFacil", millis() - tInicioJuego, "perdio");
            return;
        }

        if (millis() - tFrame < 33)
            continue;

        tFrame = millis();

        int rawH = analogRead(JOY_HOR);
        int rawV = analogRead(JOY_VER);

        float dx = abs(rawH - 2048) > ZONA_MUERTA ?
                   (rawH - 2048) / 2048.0f * VEL : 0;

        float dy = abs(rawV - 2048) > ZONA_MUERTA ?
                   (rawV - 2048) / 2048.0f * VEL : 0;

        int ix = constrain(cx + dx, 1, 126);
        int iy = constrain(cy + dy, 1, 62);

        // Hay tolerancia: pierde unicamente cuando ninguno de los pixeles
        // del cursor 3x3 conserva contacto con el camino.
        if (!cursorSobreLinea(epd_bitmap_Traza_Facil, ix, iy, RADIO_CURSOR))
        {
            dibujarJuegoNavegacion(epd_bitmap_Traza_Facil, ix, iy, 1);
            animacionGameOverNav();
            enviarMetricaJuego("trazaFacil", millis() - tInicioJuego, "perdio");
            return;
        }

        cx = ix;
        cy = iy;

        if (abs(ix - META_X) + abs(iy - META_Y) <= RADIO_META)
        {
            dibujarJuegoNavegacion(epd_bitmap_Traza_Facil, ix, iy, 1);
            animacionVictoriaNav();
            enviarMetricaJuego("trazaFacil", millis() - tInicioJuego, "gano");
            return;
        }

        dibujarJuegoNavegacion(epd_bitmap_Traza_Facil, ix, iy, 1);
    }
}

// ============================================================
//  RESCATE
//  - Fondo negro con obstaculos BLANCOS (circulos)
//  - El cursor inicia en el extremo izquierdo (x ~ 2, y ~ 32)
//  - Gana cuando llega al extremo derecho (x >= 118)
//  - Pierde si toca cualquier pixel BLANCO (obstaculo)
// ============================================================
void iniciarRescate() {
  // Mostrar el campo al inicio
  display.clearDisplay();
  display.drawBitmap(0, 0, epd_bitmap_Rescate, 128, 64, 1);
  display.display();
  delay(800);

  // Punto de inicio: extremo izquierdo, centro vertical
  // Buscamos el primer pixel negro en la columna x=2, cerca de y=32
  int startX = 2, startY = 32;
  for (int y = 32; y < 64; y++) {
    if (!pixelEnBitmap(epd_bitmap_Rescate, 2, y)) {
      startY = y;
      goto inicio_rescate_ok;
    }
  }
  for (int y = 31; y >= 0; y--) {
    if (!pixelEnBitmap(epd_bitmap_Rescate, 2, y)) {
      startY = y;
      goto inicio_rescate_ok;
    }
  }
  inicio_rescate_ok:

  float cx = startX;
  float cy = startY;
  unsigned long tInicioJuego = millis();

  // Meta: llegar a x >= 118 (extremo derecho)
  const int   META_X      = 118;
  const float VEL         = 1.4f;
  const int   ZONA_MUERTA = 600;
  unsigned long tFrame    = 0;


  while (true) {
    // Salir con JOY_SW
    if (digitalRead(JOY_SW) == LOW) {
      delay(300);
      enviarMetricaJuego("rescate", millis() - tInicioJuego, "perdio");
      return; }

    // ~30 fps
    unsigned long ahora = millis();
    if (ahora - tFrame < 33) continue;
    tFrame = ahora;

    // Leer joystick
    int rawH = analogRead(JOY_HOR);
    int rawV = analogRead(JOY_VER);
    float dx = 0, dy = 0;
    if (abs(rawH - 2048) > ZONA_MUERTA) dx = (rawH - 2048) / 2048.0f * VEL;
    if (abs(rawV - 2048) > ZONA_MUERTA) dy = (rawV - 2048) / 2048.0f * VEL;

    float nx = constrain(cx + dx, 1, 126);
    float ny = constrain(cy + dy, 1, 62);
    int   ix = (int)nx;
    int   iy = (int)ny;

    // Colision: si toca un pixel BLANCO (obstaculo) = pierde
    // Cursor de 3x3: chequear area completa para ser justo
    bool colision = false;
    for (int dy2 = -1; dy2 <= 1 && !colision; dy2++)
      for (int dx2 = -1; dx2 <= 1 && !colision; dx2++)
        if (pixelEnBitmap(epd_bitmap_Rescate, ix + dx2, iy + dy2))
          colision = true;

    if (colision) {
      dibujarJuegoNavegacion(epd_bitmap_Rescate, (int)cx, (int)cy, 1);
      animacionGameOverNav();
      enviarMetricaJuego("rescate", millis() - tInicioJuego, "perdio");
      return;
    }

    // Mover cursor
    cx = nx;
    cy = ny;

    // Verificar llegada al extremo derecho
    if (ix >= META_X) {
      dibujarJuegoNavegacion(epd_bitmap_Rescate, ix, iy, 1);
      animacionVictoriaNav();
      enviarMetricaJuego("rescate", millis() - tInicioJuego, "gano");
      return;
    }

    dibujarJuegoNavegacion(epd_bitmap_Rescate, ix, iy, 1);
  }
}
// ── LOGICA DE SIMON DICE ─────────────────────────


void mostrarPuntaje(){
  display.clearDisplay();

  display.setTextSize(2);
  display.setTextColor(SSD1306_WHITE);

  display.setCursor(15,0);
  display.println("SIMON");

  display.setCursor(0,35);
  display.print("Score:");
  display.print(max(0, (int)gameIndex - 1));

  display.display();
}

void lightLedAndPlayTone(byte ledIndex){
  digitalWrite(ledPins[ledIndex], HIGH);

  tone(BUZZER_PIN, gameTones[ledIndex]);

  delay(300);

  noTone(BUZZER_PIN);

  digitalWrite(ledPins[ledIndex], LOW);
  }

int readButtons(){
  while(true)
  {
    if(digitalRead(JOY_SW)==LOW)
    {
      delay(300);
      return -1;
    }

    for(byte i=0;i<4;i++)
    {
      if(digitalRead(buttonPins[i])==LOW)
      {
        delay(50);

        while(digitalRead(buttonPins[i])==LOW);

        return i;
      }
    }
  }
}



void playSequence(){
  for(int i=0;i<gameIndex;i++)
  {
    lightLedAndPlayTone(gameSequence[i]);
    delay(100);
  }
}



bool checkUserSequence(){
  for(int i=0;i<gameIndex;i++)
  {
    int actualButton = readButtons();

    if(actualButton==-1)
      return false;

    lightLedAndPlayTone(actualButton);

    if(actualButton!=gameSequence[i])
      return false;
  }

  return true;
}

void playLevelUpSound(){
  int notas[] = {330,392,659,523,587,784};

  for(int i=0;i<6;i++)
  {
    tone(BUZZER_PIN, notas[i]);
    delay(120);
  }

  noTone(BUZZER_PIN);
}

void gameOver(){
  display.clearDisplay();

  display.setTextSize(2);

  display.setCursor(0,20);
  display.println("GAME OVER");

  display.display();

  digitalWrite(LED_NARANJA,HIGH);
  tone(BUZZER_PIN,180);

  delay(2000);

  noTone(BUZZER_PIN);
  digitalWrite(LED_NARANJA,LOW);

}



void iniciarSimonDice(){
  gameIndex = 0;
  unsigned long tInicioJuego = millis();

  while(true)
  {
    if(digitalRead(JOY_SW)==LOW)
    {
      delay(300);
      String resultado = "puntaje " + String(max(0, (int)gameIndex - 1)); 
      enviarMetricaJuego("Simon dice", millis() - tInicioJuego, resultado);
      return;
    }

    mostrarPuntaje();

    gameSequence[gameIndex] = random(0,4);

    gameIndex++;

    if(gameIndex>=MAX_GAME_LENGTH)
      gameIndex=MAX_GAME_LENGTH-1;

    playSequence();

    bool correcto = checkUserSequence();

    if(digitalRead(JOY_SW)==LOW)
    {
      delay(300);
      String resultado = "puntaje " + String(max(0, (int)gameIndex - 1)); 
      enviarMetricaJuego("Simon dice", millis() - tInicioJuego, resultado);
      return;
    }

    if(!correcto)
    {
      int puntaje = max(0, (int)gameIndex-1);
      gameOver();
      String resultado = "puntaje" + String(puntaje);
      enviarMetricaJuego("Simon dice", millis()-tInicioJuego, resultado);
      return;
    }

    playLevelUpSound();

    delay(300);
  }
}



// ── LOGICA PARA PINTA FELIZ ─────────────────────────


bool pixelEnBitmap(const unsigned char* bmp, int x, int y) {
  if (x < 0 || x >= 128 || y < 0 || y >= 64) return false;
  int idx = (y * 128 + x) / 8;
  int bit = 7 - ((y * 128 + x) % 8);
  return (pgm_read_byte(&bmp[idx]) >> bit) & 0x01;
}

// ── Buffers en RAM ────────────────────────────────────────────
// exteriorBuffer: 1 bit por pixel, 1 = exterior, 0 = interior o contorno
uint8_t exteriorBuffer[64][16];

// paintBuffer: 1 bit por pixel, 1 = pintado por el jugador
uint8_t paintBuffer[64][16];

// Stack para el flood-fill (máx 8192 posiciones = 16 KB)
// Posición = y * 128 + x  (uint16_t cabe en 0..8191)
static uint16_t ffStack[8192];

// ── Operaciones sobre los buffers ────────────────────────────
void setBit(uint8_t buf[][16], int x, int y) {
  if (x < 0 || x >= 128 || y < 0 || y >= 64) return;
  buf[y][x / 8] |= (0x80 >> (x % 8));
}
bool getBit(uint8_t buf[][16], int x, int y) {
  if (x < 0 || x >= 128 || y < 0 || y >= 64) return false;
  return (buf[y][x / 8] >> (7 - (x % 8))) & 0x01;
}

// ── Flood-fill iterativo desde (sx, sy) ──────────────────────
// Marca en exteriorBuffer todos los pixels negros (no-contorno)
// alcanzables desde (sx,sy) sin cruzar pixels blancos del bitmap.
void floodFillExterior(const unsigned char* bmp, int sx, int sy) {
  if (pixelEnBitmap(bmp, sx, sy)) return; // punto inicial es contorno
  if (getBit(exteriorBuffer, sx, sy))     return; // ya visitado

  int top = 0;
  ffStack[top++] = (uint16_t)(sy * 128 + sx);
  setBit(exteriorBuffer, sx, sy);

  const int8_t dx[4] = {1, -1, 0,  0};
  const int8_t dy[4] = {0,  0, 1, -1};

  while (top > 0) {
    uint16_t pos = ffStack[--top];
    int cx = pos % 128;
    int cy = pos / 128;

    for (int d = 0; d < 4; d++) {
      int nx = cx + dx[d];
      int ny = cy + dy[d];
      if (nx < 0 || nx >= 128 || ny < 0 || ny >= 64) continue;
      if (pixelEnBitmap(bmp, nx, ny))    continue; // contorno = barrera
      if (getBit(exteriorBuffer, nx, ny)) continue; // ya marcado
      setBit(exteriorBuffer, nx, ny);
      if (top < 8191)  // proteger overflow
        ffStack[top++] = (uint16_t)(ny * 128 + nx);
    }
  }
}

// ── Pre-calcular mapa de exterior antes de cada nivel ─────────
// Hace flood-fill desde las 4 esquinas y los bordes para
// asegurar que TODO el exterior quede marcado.
void preCalcularExterior(const unsigned char* bmp) {
  memset(exteriorBuffer, 0, sizeof(exteriorBuffer));

  // Flood desde las 4 esquinas
  floodFillExterior(bmp, 0,   0);
  floodFillExterior(bmp, 127, 0);
  floodFillExterior(bmp, 0,   63);
  floodFillExterior(bmp, 127, 63);

  // Barrer todos los bordes por si alguna esquina es contorno
  for (int x = 0; x < 128; x++) {
    floodFillExterior(bmp, x, 0);
    floodFillExterior(bmp, x, 63);
  }
  for (int y = 0; y < 64; y++) {
    floodFillExterior(bmp, 0,   y);
    floodFillExterior(bmp, 127, y);
  }
}

// ── Verifica si (x,y) es exterior (mapa pre-calculado) ───────
// true  → exterior → pierde si el cursor llega aquí
// false → interior o contorno → puede seguir jugando
bool esExterior(int x, int y) {
  if (x < 0 || x >= 128 || y < 0 || y >= 64) return true;
  return getBit(exteriorBuffer, x, y);
}

// ── Busca automáticamente el punto de inicio interior ─────────
// Escanea la fila central (y=32) y busca el primer pixel negro
// que NO sea exterior (es decir, que sea interior real).
// Si no encuentra en y=32, prueba filas cercanas.
bool buscarPuntoInicio(const unsigned char* bmp, int &outX, int &outY) {
  for (int dy = 0; dy < 32; dy++) {
    for (int signo = 0; signo <= 1; signo++) {
      int y = 32 + (signo == 0 ? dy : -dy);
      if (y < 0 || y >= 64) continue;
      for (int x = 0; x < 128; x++) {
        if (!pixelEnBitmap(bmp, x, y) && !esExterior(x, y)) {
          outX = x;
          outY = y;
          return true;
        }
      }
    }
  }
  return false; // no encontró (bitmap sin interior)
}

// ── Marca pixel como pintado ──────────────────────────────────
void marcarPixel(int x, int y) { setBit(paintBuffer, x, y); }
bool pixelPintado(int x, int y) { return getBit(paintBuffer, x, y); }

// ── Pinta área gruesa 5×5 alrededor del cursor ───────────────
// Solo pinta pixels que son INTERIOR (no contorno, no exterior)
void pintarAreaGruesa(const unsigned char* bmp, int cx, int cy) {
  const int RADIO = 2;
  for (int dy = -RADIO; dy <= RADIO; dy++)
    for (int dx = -RADIO; dx <= RADIO; dx++) {
      int px = cx + dx, py = cy + dy;
      if (!pixelEnBitmap(bmp, px, py) && !esExterior(px, py))
        marcarPixel(px, py);
    }
}

// ── Cuenta pixels interiores totales ─────────────────────────
int contarInterior(const unsigned char* bmp) {
  int total = 0;
  for (int y = 0; y < 64; y++)
    for (int x = 0; x < 128; x++)
      if (!pixelEnBitmap(bmp, x, y) && !esExterior(x, y))
        total++;
  return total;
}

// ── Cuenta pixels interiores ya pintados ─────────────────────
int contarPintados(const unsigned char* bmp) {
  int cnt = 0;
  for (int y = 0; y < 64; y++)
    for (int x = 0; x < 128; x++)
      if (!pixelEnBitmap(bmp, x, y) && !esExterior(x, y) && pixelPintado(x, y))
        cnt++;
  return cnt;
}

// ── Dibuja contorno + pintura + cursor ───────────────────────
void dibujarPinta(const unsigned char* bmp, int cx, int cy) {
  display.clearDisplay();
  display.drawBitmap(0, 0, bmp, 128, 64, 1);
  for (int y = 0; y < 64; y++)
    for (int x = 0; x < 128; x++)
      if (pixelPintado(x, y))
        display.drawPixel(x, y, SSD1306_WHITE);
  // Cursor 3×3
  for (int dy = -1; dy <= 1; dy++)
    for (int dx = -1; dx <= 1; dx++)
      display.drawPixel(cx + dx, cy + dy, SSD1306_WHITE);
  display.display();
}

// ── Animaciones ───────────────────────────────────────────────
void animacionGameOverPinta() {
  tone(BUZZER_PIN, 150); digitalWrite(LED_NARANJA, HIGH);
  delay(350); noTone(BUZZER_PIN);
  tone(BUZZER_PIN, 100); delay(350); noTone(BUZZER_PIN);
  tone(BUZZER_PIN, 80);  delay(500); noTone(BUZZER_PIN);
  digitalWrite(LED_NARANJA, LOW);
  display.clearDisplay();
  display.setTextSize(1);
  display.setTextColor(SSD1306_WHITE);
  display.setCursor(25, 18); display.println("Te saliste");
  display.setCursor(16, 36); display.println("de la linea :(");
  display.display();
  delay(2000);
}

void animacionNivelOkPinta(int nivel) {
  int notas[] = {523, 659, 784, 1047};
  for (int i = 0; i < 4; i++) { tone(BUZZER_PIN, notas[i]); delay(110); }
  noTone(BUZZER_PIN);
  for (int i = 0; i < 3; i++) {
    for (int j = 0; j < 4; j++) digitalWrite(ledPins[j], HIGH);
    delay(140);
    for (int j = 0; j < 4; j++) digitalWrite(ledPins[j], LOW);
    delay(140);
  }
  display.clearDisplay();
  display.setTextSize(2);
  display.setTextColor(SSD1306_WHITE);
  display.setCursor(5, 5);  display.println("NIVEL");
  display.setCursor(5, 30); display.print(nivel); display.println(" OK!");
  display.display();
  delay(1500);
}

void animacionVictoriaPinta() {
  int notas[] = {523,587,659,698,784,880,988,1047};
  for (int i = 0; i < 8; i++) { tone(BUZZER_PIN, notas[i]); delay(90); }
  noTone(BUZZER_PIN);
  display.clearDisplay();
  display.setTextSize(2);
  display.setTextColor(SSD1306_WHITE);
  display.setCursor(5, 5);  display.println("GANASTE");
  display.setCursor(5, 35); display.println("  :)");
  display.display();
  for (int i = 0; i < 5; i++) {
    for (int j = 0; j < 4; j++) digitalWrite(ledPins[j], HIGH);
    digitalWrite(LED_NARANJA, HIGH);
    delay(200);
    for (int j = 0; j < 4; j++) digitalWrite(ledPins[j], LOW);
    digitalWrite(LED_NARANJA, LOW);
    delay(200);
  }
  delay(800);
}

// ── Juega un nivel ────────────────────────────────────────────
bool jugarNivelPinta(const unsigned char* bmp) {
  // 1. Pre-calcular mapa de exterior (solo una vez por nivel)
  display.clearDisplay();
  display.setTextSize(1);
  display.setTextColor(SSD1306_WHITE);
  display.setCursor(20, 28);
  display.println("Cargando...");
  display.display();

  preCalcularExterior(bmp);
  memset(paintBuffer, 0, sizeof(paintBuffer));

  // 2. Buscar punto de inicio interior automáticamente
  int startX = 64, startY = 32;
  if (!buscarPuntoInicio(bmp, startX, startY)) {
    return true; // bitmap sin interior = nivel trivial
  }

  float cx = startX;
  float cy = startY;

  int totalInterior = contarInterior(bmp);
  if (totalInterior == 0) return true;

  // 80% pintado = nivel completado
  int umbral = (int)(totalInterior * 0.80f);

  const float VEL         = 1.5f;
  const int   ZONA_MUERTA = 600;
  unsigned long tFrame    = 0;

  // Mostrar figura antes de empezar
  display.clearDisplay();
  display.drawBitmap(0, 0, bmp, 128, 64, 1);
  display.display();
  delay(600);

  while (true) {
    // Salir con JOY_SW
    if (digitalRead(JOY_SW) == LOW) { delay(300); return false; }

    // ~30 fps
    unsigned long ahora = millis();
    if (ahora - tFrame < 33) continue;
    tFrame = ahora;

    // Leer joystick
    int rawH = analogRead(JOY_HOR);
    int rawV = analogRead(JOY_VER);
    float dx = 0, dy = 0;
    if (abs(rawH - 2048) > ZONA_MUERTA) dx = (rawH - 2048) / 2048.0f * VEL;
    if (abs(rawV - 2048) > ZONA_MUERTA) dy = (rawV - 2048) / 2048.0f * VEL;

    float nx = constrain(cx + dx, 0, 127);
    float ny = constrain(cy + dy, 0, 63);
    int   ix = (int)nx;
    int   iy = (int)ny;

    // ── NUEVA LÓGICA: pierde solo si llega al EXTERIOR ───────
    // El contorno blanco NO hace perder (no está en exteriorBuffer)
    if (esExterior(ix, iy)) {
      dibujarPinta(bmp, (int)cx, (int)cy);
      animacionGameOverPinta();
      return false;
    }

    // Mover cursor y pintar
    cx = nx;
    cy = ny;
    pintarAreaGruesa(bmp, ix, iy);

    // Verificar completado
    if (contarPintados(bmp) >= umbral) {
      dibujarPinta(bmp, ix, iy);
      return true;
    }

    dibujarPinta(bmp, ix, iy);
  }
}

// ── Función principal Pinta Feliz ─────────────────────────────
void iniciarPintaFeliz() {
  const unsigned char* niveles[3] = {
    epd_bitmap_PintaFeliz_N1,
    epd_bitmap_PintaFeliz_N2,
    epd_bitmap_PintaFeliz_N3
  };

  int nivel = 0;
  unsigned long tInicioJuego = millis();
  while (nivel < 3) {
    // Mostrar figura del nivel
    display.clearDisplay();
    display.drawBitmap(0, 0, niveles[nivel], 128, 64, 1);
    display.display();
    delay(500);

    bool completo = jugarNivelPinta(niveles[nivel]);

    if (completo) {
      if (nivel < 2) { animacionNivelOkPinta(nivel + 1); nivel++; }
      else           {
        animacionVictoriaPinta(); 
        String resultado = "nivel " + String(nivel + 1);    
        enviarMetricaJuego("Pinta feliz", millis() - tInicioJuego, resultado);
        return; 
      }
    } else {
      String resultado = "nivel " + String(nivel + 1);    
      enviarMetricaJuego("Pinta feliz", millis() - tInicioJuego, resultado);
      return; // game over o JOY_SW → vuelve al menú
    }
  }
}
